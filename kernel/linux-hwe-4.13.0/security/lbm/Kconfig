## kernel/linux-hwe-4.13.0/security/lbm/Kconfig
```kconfig
config LBM
	bool "LBM support"
	depends on SECURITY
	depends on BPF
	depends on BPF_JIT
	default y
	help
	  Linux (e)BPF Modules for peripheral security for the Linux kernel

	  If you are unsure how to answer this question, answer N.
```
